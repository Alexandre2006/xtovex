## CMakeLists.txt
```
# SPDX-License-Identifier: Apache-2.0

cmake_minimum_required(VERSION 3.20.0)

find_package(Zephyr REQUIRED HINTS $ENV{ZEPHYR_BASE})
project(xtovex2)

# Include all .c and .h files in the src directory and its subdirectories
file(GLOB app_sources src/*.c src/*.h src/*/*.c src/*/*.h)
target_sources(app PRIVATE
  ${app_sources}
  )

zephyr_library_include_directories(${ZEPHYR_BASE}/samples/bluetooth)
```

## prj.conf
```kconfig
# Bluetooth: Main Configuration
CONFIG_BT=y
CONFIG_LOG=y
CONFIG_BT_SMP=y
CONFIG_BT_PERIPHERAL=y
CONFIG_BT_DEVICE_NAME="XToVEX Adapter"
CONFIG_BT_DEVICE_APPEARANCE=833
CONFIG_BT_GATT_DYNAMIC_DB=y

# USB: Main Configuration
CONFIG_USB_DEVICE_STACK=y
CONFIG_USB_DEVICE_PRODUCT="XToVEX Adapter - Console"
CONFIG_USB_DEVICE_MANUFACTURER="ThinkAlex Inc."
CONFIG_USB_DEVICE_SN="L6HGA6UB"

# USB: Serial Logging
CONFIG_CONSOLE=y
CONFIG_STDOUT_CONSOLE=y
CONFIG_USB_DRIVER_LOG_LEVEL_INF=y
CONFIG_USB_DEVICE_LOG_LEVEL_INF=y
CONFIG_SERIAL=y
CONFIG_UART_INTERRUPT_DRIVEN=y
CONFIG_UART_LINE_CTRL=y
CONFIG_USB_DEVICE_INITIALIZE_AT_BOOT=y
```

## src/main.c
```c
#include <zephyr/types.h>
#include <stddef.h>
#include <string.h>
#include <errno.h>
#include <stdio.h>
#include <zephyr/sys/printk.h>
#include <zephyr/sys/byteorder.h>
#include <zephyr/kernel.h>
#include <zephyr/device.h>

#include <zephyr/bluetooth/bluetooth.h>
#include <zephyr/bluetooth/hci.h>
#include <zephyr/bluetooth/conn.h>
#include <zephyr/bluetooth/uuid.h>
#include <zephyr/bluetooth/gatt.h>
#include <zephyr/bluetooth/services/dis.h>

#include "config/vexconf.h"
#include "usb/usb_serial.h"
#include "bluetooth/vex_primary.h"

static const struct bt_data advertisement_data[] = {
	BT_DATA_BYTES(BT_DATA_FLAGS, (BT_LE_AD_GENERAL | BT_LE_AD_NO_BREDR)),
	BT_DATA_BYTES(BT_DATA_MANUFACTURER_DATA, { 0x06, 0x77, 0x10, 0x30, 0x00, 0x59, 0x83, 0x52, 0x40, 0x00, 0x4B, 0x40, 0x00, 0x11, 0x11, 0x02, 0x8F, 0xC5, 0x83, 0x00 }),
	BT_DATA_BYTES(BT_DATA_UUID128_ALL, {VEX_CONTROLLER_DATA_SERVICE_UUID}),
	BT_DATA_BYTES(BT_DATA_UUID16_ALL,
				  BT_UUID_16_ENCODE(BT_UUID_DIS_VAL))};

static void connected(struct bt_conn *conn, uint8_t err)
{
	if (err)
	{
		printk("Connection failed (err 0x%02x)\n", err);
	}
	else
	{
		printk("Connected\n");
	}
}

static void disconnected(struct bt_conn *conn, uint8_t reason)
{
	printk("Disconnected (reason 0x%02x)\n", reason);
}

static void identity_resolved(struct bt_conn *conn, const bt_addr_le_t *rpa,
							  const bt_addr_le_t *identity)
{
	char addr[BT_ADDR_LE_STR_LEN];
	bt_addr_le_to_str(identity, addr, sizeof(addr));
	printk("Identity resolved %s\n", addr);
}

static void le_param_req(struct bt_conn *conn, struct bt_le_conn_param *param)
{
	printk("LE conn param req: int (0x%04x, 0x%04x) lat %d to %d\n",
		   param->interval_min, param->interval_max,
		   param->latency, param->timeout);
}

static void le_param_updated(struct bt_conn *conn, uint16_t interval,
							 uint16_t latency, uint16_t timeout)
{
	printk("LE conn param updated: int 0x%04x lat 0x%04x to 0x%04x\n",
		   interval, latency, timeout);
}

BT_CONN_CB_DEFINE(conn_callbacks) = {
	.connected = connected,
	.disconnected = disconnected,
	.identity_resolved = identity_resolved,
	.le_param_req = le_param_req,
	.le_param_updated = le_param_updated,
};

static void bt_ready(void)
{
	int err;

	printk("Bluetooth initialized\n");

	// Register primary service
	err = vex_primary_services_init();

	if (err)
	{
		printk("Primary service init failed (err %d)\n", err);
		return;
	}

	err = bt_le_adv_start(BT_LE_ADV_CONN_NAME, advertisement_data, ARRAY_SIZE(advertisement_data), NULL, 0);
	if (err)
	{
		printk("Advertising failed to start (err %d)\n", err);
		return;
	}

	printk("Advertising successfully started\n");
}

int main(void)
{
	/*
	 * USB Device Configuration
	 */
	const struct device *dev;

    dev = DEVICE_DT_GET_ONE(zephyr_cdc_acm_uart);
    usb_setup(dev);

	/*
	 * Bluetooth Device Configuration
	 */
	int err;

	// Set MAC Address
	bt_addr_le_t addr;
	err = bt_addr_le_from_str(MAC_ADDRESS, "public", &addr);
	if (err) {
		printk("Invalid BT address (err %d)\n", err);
	}

	err = bt_ctlr_set_public_addr(addr.a.val);

	if (err)
	{
		printk("Bluetooth set public address failed (err %d)\n", err);
		return 0;
	}

	// Enable Bluetooth
	err = bt_enable(NULL);
	if (err)
	{
		printk("Bluetooth init failed (err %d)\n", err);
		return 0;
	}

	bt_ready();

	// while (1)
	// {
	// 	k_sleep(K_SECONDS(1));
	// }
	// return 0;

	while (true) {
		// Get current value
		uint8_t *val = get_dataiq_value();

		// Increment value
		*val += 1;

		// Set new value
		set_dataiq_value(val);

		// Wait
		k_sleep(K_MSEC(10));
	}
}
```

## src/usb_serial.c
```c
#include "usb_serial.h"
LOG_MODULE_REGISTER(usb_serial);

uint8_t ring_buffer[RING_BUF_SIZE];
struct ring_buf ringbuf;
bool rx_throttled;

void interrupt_handler(const struct device *dev, void *user_data)
{
	ARG_UNUSED(user_data);

	while (uart_irq_update(dev) && uart_irq_is_pending(dev)) {
		if (!rx_throttled && uart_irq_rx_ready(dev)) {
			int recv_len, rb_len;
			uint8_t buffer[64];
			size_t len = MIN(ring_buf_space_get(&ringbuf),
					 sizeof(buffer));

			if (len == 0) {
				/* Throttle because ring buffer is full */
				uart_irq_rx_disable(dev);
				rx_throttled = true;
				continue;
			}

			recv_len = uart_fifo_read(dev, buffer, len);
			if (recv_len < 0) {
				LOG_ERR("Failed to read UART FIFO");
				recv_len = 0;
			};

			rb_len = ring_buf_put(&ringbuf, buffer, recv_len);
			if (rb_len < recv_len) {
				LOG_ERR("Drop %u bytes", recv_len - rb_len);
			}

			LOG_DBG("tty fifo -> ringbuf %d bytes", rb_len);
			if (rb_len) {
				uart_irq_tx_enable(dev);
			}
		}

		if (uart_irq_tx_ready(dev)) {
			uint8_t buffer[64];
			int rb_len, send_len;

			rb_len = ring_buf_get(&ringbuf, buffer, sizeof(buffer));
			if (!rb_len) {
				LOG_DBG("Ring buffer empty, disable TX IRQ");
				uart_irq_tx_disable(dev);
				continue;
			}

			if (rx_throttled) {
				uart_irq_rx_enable(dev);
				rx_throttled = false;
			}

			send_len = uart_fifo_fill(dev, buffer, rb_len);
			if (send_len < rb_len) {
				LOG_ERR("Drop %d bytes", rb_len - send_len);
			}

			LOG_DBG("ringbuf -> tty fifo %d bytes", send_len);
		}
	}
}

void usb_setup(const struct device *dev) {
    uint32_t baudrate, dtr = 0U;
    int ret;

    if (!device_is_ready(dev)) {
        LOG_ERR("CDC ACM device not ready");
        return;
    }

    ring_buf_init(&ringbuf, sizeof(ring_buffer), ring_buffer);

    LOG_INF("Wait for DTR");

    while (true) {
        uart_line_ctrl_get(dev, UART_LINE_CTRL_DTR, &dtr);
        if (dtr) {
            break;
        } else {
            /* Give CPU resources to low priority threads. */
            k_sleep(K_MSEC(100));
        }
    }

    LOG_INF("DTR set");

    /* They are optional, we use them to test the interrupt endpoint */
    ret = uart_line_ctrl_set(dev, UART_LINE_CTRL_DCD, 1);
    if (ret) {
        LOG_WRN("Failed to set DCD, ret code %d", ret);
    }

    ret = uart_line_ctrl_set(dev, UART_LINE_CTRL_DSR, 1);
    if (ret) {
        LOG_WRN("Failed to set DSR, ret code %d", ret);
    }

    /* Wait 100ms for the host to do all settings */
    k_msleep(100);

    ret = uart_line_ctrl_get(dev, UART_LINE_CTRL_BAUD_RATE, &baudrate);
    if (ret) {
        LOG_WRN("Failed to get baudrate, ret code %d", ret);
    } else {
        LOG_INF("Baudrate detected: %d", baudrate);
    }

    uart_irq_callback_set(dev, interrupt_handler);

    /* Enable rx interrupts */
    uart_irq_rx_enable(dev);
}
```

## src/vexconf.h
```c
#define MAC_ADDRESS "A4:34:F1:7F:24:9F"

/*
 * Device Info:
 *  - Device UUID: 068708B5-C055-9225-E7F3-D86FDF88A678
 *  - Advertisement Manufacturer Data: 0x067710300059835240004b40001111028fc58300 (20 bytes)
 *  - TX Power: 0x00
 *  - Connectable: true
 *  - Device Local Name: "        "
*/

#define DEVICE_UUID { 0x68, 0x87, 0x08, 0xB5, 0xC0, 0x55, 0x92, 0x25, 0xE7, 0xF3, 0xD8, 0x6F, 0xDF, 0x88, 0xA6, 0x78 }
#define MANUFACTURER_DATA { 0x06, 0x77, 0x10, 0x30, 0x00, 0x59, 0x83, 0x52, 0x40, 0x00, 0x4B, 0x40, 0x00, 0x11, 0x11, 0x02, 0x8F, 0xC5, 0x83, 0x00 }
#define DEVICE_LOCAL_NAME "XToVEX Adapter"

/*
 * Vex Controller Data Service:
 * 
 * Service UUID: 08590F7E-DB05-467E-8757-72F6FAEB13A5
 * - Characteristic UUID: 08590F7E-DB05-467E-8757-72F6FAEB13B5 (Data for Vex IQ Hardware)
 *   - Characteristic User Description: "DataIQ"
 *   - Client Characteristic Configuration: 0x01 (1 byte)
 *   - Capability: Read, Notify
 *   - Default Value: 0x0000000000000000000000000000 (14 bytes)
 * - Characteristic UUID: 08590F7E-DB05-467E-8757-72F6FAEB13C5 (Unsure of use, seems to always be 0x1900)
 *   - Characteristic User Description: "Status."
 *   - Capability: Write, Read
 *   - Default Value: 0x1900 (2 bytes)
 * - Characteristic UUID: 08590F7E-DB05-467E-8757-72F6FAEB1336 (Data for Vex EDR/V5 Hardware)
 *   - Characteristic User Description: "DataEDR"
 *   - Client Characteristic Configuration: 0x01 (1 byte)
 *   - Capability: Read, Notify
 *   - Default Value: 0x0000000000000000000000000000000000000000 (20 bytes)
 * - Characteristic UUID: 08590F7E-DB05-467E-8757-72F6FAEB1337 (Unsure of use, seems to have filename when file is selected on V5)
 *   - Characteristic User Description: "DeviceStatus"
 *   - Capability: Write, Read
 *   - Default Value: 0x00000000000000000000000000000000000000000000000000000000 (28 bytes)
 */

#define VEX_CONTROLLER_DATA_SERVICE_UUID { 0x08, 0x59, 0x0F, 0x7E, 0xDB, 0x05, 0x46, 0x7E, 0x87, 0x57, 0x72, 0xF6, 0xFA, 0xEB, 0x13, 0xA5 }

#define VEX_CONTROLLER_DATA_CHARACTERISTIC_DATA_IQ_UUID { 0x08, 0x59, 0x0F, 0x7E, 0xDB, 0x05, 0x46, 0x7E, 0x87, 0x57, 0x72, 0xF6, 0xFA, 0xEB, 0x13, 0xB5 }
#define VEX_CONTROLLER_DATA_CHARACTERISTIC_DATA_IQ_USER_DESCRIPTION "DataIQ"
#define VEX_CONTROLLER_DATA_CHARACTERISTIC_DATA_IQ_CLIENT_CHARACTERISTIC_CONFIGURATION 0x01
#define VEX_CONTROLLER_DATA_CHARACTERISTIC_DATA_IQ_DEFAULT_VALUE 0x0000000000000000000000000000

#define VEX_CONTROLLER_DATA_CHARACTERISTIC_STATUS_UUID { 0x08, 0x59, 0x0F, 0x7E, 0xDB, 0x05, 0x46, 0x7E, 0x87, 0x57, 0x72, 0xF6, 0xFA, 0xEB, 0x13, 0xC5 }
#define VEX_CONTROLLER_DATA_CHARACTERISTIC_STATUS_USER_DESCRIPTION "Status."
#define VEX_CONTROLLER_DATA_CHARACTERISTIC_STATUS_DEFAULT_VALUE 0x1900

#define VEX_CONTROLLER_DATA_CHARACTERISTIC_DATA_EDR_UUID { 0x08, 0x59, 0x0F, 0x7E, 0xDB, 0x05, 0x46, 0x7E, 0x87, 0x57, 0x72, 0xF6, 0xFA, 0xEB, 0x13, 0x36 }
#define VEX_CONTROLLER_DATA_CHARACTERISTIC_DATA_EDR_USER_DESCRIPTION "DataEDR"
#define VEX_CONTROLLER_DATA_CHARACTERISTIC_DATA_EDR_CLIENT_CHARACTERISTIC_CONFIGURATION 0x01
#define VEX_CONTROLLER_DATA_CHARACTERISTIC_DATA_EDR_DEFAULT_VALUE 0x0000000000000000000000000000000000000000

#define VEX_CONTROLLER_DATA_CHARACTERISTIC_DEVICE_STATUS_UUID { 0x08, 0x59, 0x0F, 0x7E, 0xDB, 0x05, 0x46, 0x7E, 0x87, 0x57, 0x72, 0xF6, 0xFA, 0xEB, 0x13, 0x37 }
#define VEX_CONTROLLER_DATA_CHARACTERISTIC_DEVICE_STATUS_USER_DESCRIPTION "DeviceStatus"
#define VEX_CONTROLLER_DATA_CHARACTERISTIC_DEVICE_STATUS_DEFAULT_VALUE 0x00000000000000000000000000000000000000000000000000000000

/*
* Vex Controller Serial Service:
* 
* Service UUID: 08590F7E-DB05-467E-8757-72F6FAEB13D5
* - Characteristic UUID: 08590F7E-DB05-467E-8757-72F6FAEB1306 (Unsure which serial channel this is for, but Transmit)
*   - Characteristic User Description: "TXData"
*   - Characteristic Presentation Format: 0x01 (1 byte)
*   - Capability: Notify, Indicate, WriteWithoutResponse
*   - Default Value: None
* - Characteristic UUID: 08590F7E-DB05-467E-8757-72F6FAEB1316 (Unsure which serial channel this is for, but Transmit)
*   - Characteristic User Description: "TXUser"
*   - Characteristic Presentation Format: 0x01 (1 byte)
*   - Capability: Notify, Indicate, WriteWithoutResponse
*   - Default Value: None
* - Characteristic UUID: 08590F7E-DB05-467E-8757-72F6FAEB1326 (Unsure which serial channel this is for, but Receive)
*   - Characteristic User Description: "RXUser"
*   - Characteristic Presentation Format: 0x01 (1 byte)
*   - Capability: Write, Notify, WriteWithoutResponse
*   - Default Value: None
* - Characteristic UUID: 08590F7E-DB05-467E-8757-72F6FAEB13E5 (Static Code)
*   - Characteristic User Description: "Code"
*   - Characteristic Presentation Format: 0x0 (1 byte)
*   - Capability: Write, Read, WriteWithoutResponse
*   - Default Value: 0xdeadface (4 bytes)
* - Characteristic UUID: 08590F7E-DB05-467E-8757-72F6FAEB13F5 (Unsure which serial channel this is for, but Receive)
*   - Characteristic User Description: "RXData"
*   - Characteristic Presentation Format: 0x01 (1 byte)
*   - Capability: Write, Notify, WriteWithoutResponse
*   - Default Value: None
*/

#define VEX_CONTROLLER_SERIAL_SERVICE_UUID { 0x08, 0x59, 0x0F, 0x7E, 0xDB, 0x05, 0x46, 0x7E, 0x87, 0x57, 0x72, 0xF6, 0xFA, 0xEB, 0x13, 0xD5 }

#define VEX_CONTROLLER_SERIAL_CHARACTERISTIC_TX_DATA_UUID { 0x08, 0x59, 0x0F, 0x7E, 0xDB, 0x05, 0x46, 0x7E, 0x87, 0x57, 0x72, 0xF6, 0xFA, 0xEB, 0x13, 0x06 }
#define VEX_CONTROLLER_SERIAL_CHARACTERISTIC_TX_DATA_USER_DESCRIPTION "TXData"
#define VEX_CONTROLLER_SERIAL_CHARACTERISTIC_TX_DATA_PRESENTATION_FORMAT 0x01

#define VEX_CONTROLLER_SERIAL_CHARACTERISTIC_TX_USER_UUID { 0x08, 0x59, 0x0F, 0x7E, 0xDB, 0x05, 0x46, 0x7E, 0x87, 0x57, 0x72, 0xF6, 0xFA, 0xEB, 0x13, 0x16 }
#define VEX_CONTROLLER_SERIAL_CHARACTERISTIC_TX_USER_USER_DESCRIPTION "TXUser"
#define VEX_CONTROLLER_SERIAL_CHARACTERISTIC_TX_USER_PRESENTATION_FORMAT 0x01

#define VEX_CONTROLLER_SERIAL_CHARACTERISTIC_RX_USER_UUID { 0x08, 0x59, 0x0F, 0x7E, 0xDB, 0x05, 0x46, 0x7E, 0x87, 0x57, 0x72, 0xF6, 0xFA, 0xEB, 0x13, 0x26 }
#define VEX_CONTROLLER_SERIAL_CHARACTERISTIC_RX_USER_USER_DESCRIPTION "RXUser"
#define VEX_CONTROLLER_SERIAL_CHARACTERISTIC_RX_USER_PRESENTATION_FORMAT 0x01

#define VEX_CONTROLLER_SERIAL_CHARACTERISTIC_CODE_UUID { 0x08, 0x59, 0x0F, 0x7E, 0xDB, 0x05, 0x46, 0x7E, 0x87, 0x57, 0x72, 0xF6, 0xFA, 0xEB, 0x13, 0xE5 }
#define VEX_CONTROLLER_SERIAL_CHARACTERISTIC_CODE_USER_DESCRIPTION "Code"
#define VEX_CONTROLLER_SERIAL_CHARACTERISTIC_CODE_PRESENTATION_FORMAT 0x0
#define VEX_CONTROLLER_SERIAL_CHARACTERISTIC_CODE_DEFAULT_VALUE 0xdeadface

#define VEX_CONTROLLER_SERIAL_CHARACTERISTIC_RX_DATA_UUID { 0x08, 0x59, 0x0F, 0x7E, 0xDB, 0x05, 0x46, 0x7E, 0x87, 0x57, 0x72, 0xF6, 0xFA, 0xEB, 0x13, 0xF5 }
#define VEX_CONTROLLER_SERIAL_CHARACTERISTIC_RX_DATA_USER_DESCRIPTION "RXData"
#define VEX_CONTROLLER_SERIAL_CHARACTERISTIC_RX_DATA_PRESENTATION_FORMAT 0x01
```
